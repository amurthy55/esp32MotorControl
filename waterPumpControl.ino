#include <WiFi.h>
#include <WiFiClientSecure.h>
#include <WiFiManager.h>
#include <Preferences.h>
#include <stdlib.h>
#include <time.h>

/* ===================== CONFIG ===================== */

// NORMAL WPA2 WIFI (HOTSPOT)
#define WIFI_SSID     "Surya"
#define WIFI_PASSWORD "YOUR_HOTSPOT_PASSWORD"

#define BOT_TOKEN "YOUR_TELEGRAM_BOT_TOKEN"

#define RELAY_PIN     9    // ACTIVE LOW
#define BUZZER_PIN    7
#define TANK_LOW_PIN 16
#define AC_FB_PIN    11
#define SETUP_BTN_PIN 4

#define RELAY_PULSE_MS 1000
#define WIFI_RESET_MS 10000

#define MOTOR_CONFIRM_DELAY_MS 1500
#define MOTOR_LONGRUN_MS (40UL * 60UL * 1000UL)
#define SCHEDULE_HOUR 10
#define SCHEDULE_WINDOW_MINUTES 10
#define GMT_OFFSET_SEC 19800
#define DAYLIGHT_OFFSET_SEC 0

/* ================================================= */

WiFiClientSecure client;
WiFiManager wm;
Preferences prefs;

long lastUpdateId = 0;

int64_t registeredChatId = 0;
int64_t pendingChatId    = 0;

bool tankLowReported = false;
bool motorOffReported = false;
bool motorEverStarted = false;

/* === NEW STATE FOR REQUESTED FEATURES === */
bool relayInProgress = false;
unsigned long motorStartMillis = 0;
bool longRunReported = false;
int lastScheduledYday = -1;

void sendTelegram(int64_t chatId, const String &msg);

/* ---------------- Relay ---------------- */

void relayIdle() {
  digitalWrite(RELAY_PIN, HIGH);
}

void relayPulseStart() {
  if (relayInProgress) {
    Serial.println("[RELAY] Pulse already in progress - IGNORED");
    return;
  }

  relayInProgress = true;
  Serial.println("[RELAY] START pulse");
  digitalWrite(RELAY_PIN, LOW);
  delay(RELAY_PULSE_MS);
  digitalWrite(RELAY_PIN, HIGH);
  relayInProgress = false;
  Serial.println("[RELAY] RELEASE");
}

void startMotorFlow(int64_t chatId, const String &source) {
  motorEverStarted = true;
  motorOffReported = false;
  longRunReported = false;
  motorStartMillis = 0;

  relayPulseStart();

  if (chatId) {
    sendTelegram(chatId, source + " COMMAND SENT");
  }

  delay(MOTOR_CONFIRM_DELAY_MS);

  if (digitalRead(AC_FB_PIN) == LOW) {
    motorStartMillis = millis();
    if (chatId) {
      sendTelegram(chatId, "MOTOR IS RUNNING");
    }
  } else if (chatId) {
    sendTelegram(chatId, "MOTOR START SENT - RUNNING FEEDBACK NOT DETECTED");
  }
}

/* ---------------- Telegram send ---------------- */

void sendTelegram(int64_t chatId, const String &msg) {
  if (WiFi.status() != WL_CONNECTED) return;

  Serial.println("[TG] Sending ΓåÆ " + msg);

  client.setInsecure();
  if (!client.connect("api.telegram.org", 443)) return;

  String payload =
    "chat_id=" + String((long long)chatId) +
    "&text=" + msg;

  client.println("POST /bot" + String(BOT_TOKEN) + "/sendMessage HTTP/1.1");
  client.println("Host: api.telegram.org");
  client.println("Content-Type: application/x-www-form-urlencoded");
  client.println("Content-Length: " + String(payload.length()));
  client.println("Connection: close");
  client.println();
  client.print(payload);
  client.stop();
}

/* -------- MOTOR ON inline button -------- */

void sendMotorOnButton(int64_t chatId) {
  if (WiFi.status() != WL_CONNECTED) return;

  client.setInsecure();
  if (!client.connect("api.telegram.org", 443)) return;

  String payload =
    "chat_id=" + String((long long)chatId) +
    "&text=MOTOR+CONTROLLER+READY"
    "&reply_markup=%7B%22inline_keyboard%22%3A%5B%5B%7B%22text%22%3A%22MOTOR+ON%22%2C%22callback_data%22%3A%22MOTOR_ON%22%7D%5D%5D%7D";

  client.println("POST /bot" + String(BOT_TOKEN) + "/sendMessage HTTP/1.1");
  client.println("Host: api.telegram.org");
  client.println("Content-Type: application/x-www-form-urlencoded");
  client.println("Content-Length: " + String(payload.length()));
  client.println("Connection: close");
  client.println();
  client.print(payload);
  client.stop();
}

bool hasMotorOnCommand(const String &resp) {
  return resp.indexOf("MOTOR_ON") > 0 ||
         resp.indexOf("MOTOR ON") > 0 ||
         resp.indexOf("/motor_on") > 0 ||
         resp.indexOf("/MOTOR_ON") > 0;
}

/* ---------------- Telegram poll ---------------- */

void pollTelegram() {
  if (WiFi.status() != WL_CONNECTED) return;

  client.setInsecure();
  if (!client.connect("api.telegram.org", 443)) return;

  client.println(
    "GET /bot" + String(BOT_TOKEN) +
    "/getUpdates?offset=" + String(lastUpdateId + 1) +
    " HTTP/1.1");
  client.println("Host: api.telegram.org");
  client.println("Connection: close");
  client.println();

  String resp;
  while (client.connected() || client.available()) {
    if (client.available()) resp += client.readString();
  }
  client.stop();

  if (resp.indexOf("\"update_id\":") < 0) return;

  int u = resp.lastIndexOf("\"update_id\":");
  lastUpdateId = resp.substring(u + 12).toInt();

  int c = resp.lastIndexOf("\"chat\":{\"id\":");
  if (c < 0) return;

  int start = c + 13;
  int end   = resp.indexOf(",", start);
  if (end < 0) return;

  int64_t chatId = strtoll(resp.substring(start, end).c_str(), nullptr, 10);

  if (registeredChatId == 0 &&
      (resp.indexOf("/register") > 0 || resp.indexOf("REGISTER") > 0)) {

    pendingChatId = chatId;
    sendTelegram(chatId, "Press SETUP button on device to confirm ownership");
    return;
  }

  if (registeredChatId != chatId) return;

  /* ===== MODIFIED MOTOR ON FLOW ===== */

  if (hasMotorOnCommand(resp)) {
    startMotorFlow(chatId, "TELEGRAM");
  }
}

void checkScheduledMotorStart() {
  if (!registeredChatId || WiFi.status() != WL_CONNECTED) return;

  struct tm timeinfo;
  if (!getLocalTime(&timeinfo, 100)) return;

  bool scheduledDay =
    timeinfo.tm_wday == 0 ||
    timeinfo.tm_wday == 1 ||
    timeinfo.tm_wday == 3 ||
    timeinfo.tm_wday == 5;

  if (!scheduledDay) return;

  if (timeinfo.tm_hour == SCHEDULE_HOUR &&
      timeinfo.tm_min < SCHEDULE_WINDOW_MINUTES &&
      lastScheduledYday != timeinfo.tm_yday) {

    lastScheduledYday = timeinfo.tm_yday;
    startMotorFlow(registeredChatId, "AUTO SCHEDULE");
  }
}

/* ---------------- SETUP button ---------------- */

void checkSetupButton() {
  bool pressed = (digitalRead(SETUP_BTN_PIN) == LOW);

  static bool btnWasPressed = false;

  if (pressed && !btnWasPressed) {
    btnWasPressed = true;
  }

  if (!pressed && btnWasPressed) {
    btnWasPressed = false;

    if (pendingChatId != 0) {
      registeredChatId = pendingChatId;
      prefs.putLong64("chat_id", registeredChatId);
      sendTelegram(registeredChatId, "Device registered successfully");
      sendMotorOnButton(registeredChatId);
      pendingChatId = 0;
    }
  }
}

/* ---------------- Sensors ---------------- */

void checkTankLow() {
  if (!registeredChatId) return;

  if (digitalRead(TANK_LOW_PIN) == LOW) {
    if (!tankLowReported) {
      tankLowReported = true;
      sendTelegram(registeredChatId, "WATER LEVEL LOW");
    }
  } else tankLowReported = false;
}

void checkACFeedback() {
  if (!registeredChatId || !motorEverStarted) return;

  if (digitalRead(AC_FB_PIN) == HIGH) {
    if (!motorOffReported) {
      motorOffReported = true;
      sendTelegram(registeredChatId, "TANK FULL. MOTOR OFF");
    }
  } else motorOffReported = false;
}

/* -------- NEW: 40-minute runtime check -------- */

void checkLongRun() {
  if (!motorEverStarted || longRunReported) return;

  if (motorStartMillis > 0 &&
      millis() - motorStartMillis >= MOTOR_LONGRUN_MS) {

    sendTelegram(registeredChatId, "MOTOR RUNNING OVER 40 MINS");
    longRunReported = true;
  }
}

/* ---------------- WiFi ---------------- */

void setupWiFi() {
  WiFi.mode(WIFI_STA);

  if (WiFi.SSID().length() > 0) {
    WiFi.begin();
    unsigned long t0 = millis();
    while (millis() - t0 < 15000) {
      if (WiFi.status() == WL_CONNECTED) return;
      delay(500);
    }
  }

  wm.autoConnect("PumpControl");
}

/* ---------------- Setup ---------------- */

void setup() {
  delay(2000);
  Serial.begin(115200);
  delay(1000);

  pinMode(RELAY_PIN, OUTPUT);
  pinMode(BUZZER_PIN, OUTPUT);
  pinMode(TANK_LOW_PIN, INPUT_PULLUP);
  pinMode(AC_FB_PIN, INPUT);
  pinMode(SETUP_BTN_PIN, INPUT_PULLUP);

  relayIdle();

  prefs.begin("tg", false);
  registeredChatId = prefs.getLong64("chat_id", 0);

  setupWiFi();
  configTime(GMT_OFFSET_SEC, DAYLIGHT_OFFSET_SEC, "pool.ntp.org", "time.nist.gov");

  if (registeredChatId) {
    sendMotorOnButton(registeredChatId);
    sendTelegram(registeredChatId,
      "MOTOR CONTROLLER ONLINE ΓÇö AUTO MODE READY");
  }
}

/* ---------------- Loop ---------------- */

void loop() {
  pollTelegram();
  checkSetupButton();
  checkTankLow();
  checkACFeedback();
  checkLongRun();      // <<< added
  checkScheduledMotorStart();
  relayIdle();
  delay(5000);
}
